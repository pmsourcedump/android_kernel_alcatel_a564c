/* Copyright (c) 2013, The Linux Foundation. All rights reserved.
 *
 * This program is free software; you can redistribute it and/or modify
 * it under the terms of the GNU General Public License version 2 and
 * only version 2 as published by the Free Software Foundation.
 *
 * This program is distributed in the hope that it will be useful,
 * but WITHOUT ANY WARRANTY; without even the implied warranty of
 * MERCHANTABILITY or FITNESS FOR A PARTICULAR PURPOSE.  See the
 * GNU General Public License for more details.
 */

/*---------------------------------------------------------------------------
 * This file is autogenerated file using gcdb parser. Please do not edit it.
 * Update input XML file to add a new entry or update variable in this file
 * VERSION = "1.0"
 *---------------------------------------------------------------------------*/
&mdss_mdp {
	dsi_ili9806c_fwvga_vid: qcom,mdss_dsi_ili9806c_fwvga_video {
		qcom,mdss-dsi-panel-name = "ili9806c fwvga video mode dsi panel";
		qcom,mdss-dsi-panel-controller = <&mdss_dsi0>;
		qcom,mdss-dsi-panel-type = "dsi_video_mode";
		qcom,mdss-dsi-panel-destination = "display_1";
		qcom,mdss-dsi-panel-framerate = <54>;
		qcom,mdss-dsi-virtual-channel-id = <0>;
		qcom,mdss-dsi-stream = <0>;
		qcom,mdss-dsi-panel-width = <480>;
		qcom,mdss-dsi-panel-height = <854>;
		qcom,mdss-dsi-h-front-porch = <60>;
		qcom,mdss-dsi-h-back-porch = <80>;
		qcom,mdss-dsi-h-pulse-width = <20>;
		qcom,mdss-dsi-h-sync-skew = <0>;
		qcom,mdss-dsi-v-back-porch = <16>;
		qcom,mdss-dsi-v-front-porch = <10>;
		qcom,mdss-dsi-v-pulse-width = <4>;
		qcom,mdss-dsi-h-left-border = <0>;
		qcom,mdss-dsi-h-right-border = <0>;
		qcom,mdss-dsi-v-top-border = <0>;
		qcom,mdss-dsi-v-bottom-border = <0>;
		qcom,mdss-dsi-bpp = <24>;
		qcom,mdss-dsi-color-order = <0>;
		qcom,mdss-dsi-underflow-color = <0xff>;
		qcom,mdss-dsi-border-color = <0>;
		qcom,mdss-dsi-on-command = [
			39 01 00 00 00 00 04 FF FF 98 16
			15 01 00 00 00 00 02 BA 60 
			15 01 00 00 00 00 02 B0 01 
			39 01 00 00 00 00 13 BC 03 0D 03 63 01 01 1b 11 6E 00 00 00 01 01 16 00 FF F2
			39 01 00 00 00 00 09 BD 02 13 45 67 45 67 01 23
			39 01 00 00 00 00 12 BE 03 22 22 22 22 DD CC BB AA 66 77 22 22 22 22 22 22
			39 01 00 00 00 00 03 ED 7F 0F 
			15 01 00 00 00 00 02 F3 70 
			15 01 00 00 00 00 02 B4 02
			39 01 00 00 00 00 04 C0 0F 0B 0A
			39 01 00 00 00 00 05 C1 17 85 70 20
			15 01 00 00 00 00 02 D8 50 
			15 01 00 00 00 00 02 FC 07 
			39 01 00 00 00 00 11 E0 00 0C 1C 0c 10 19 c9 06 06 0b 05 11 1B 1c 18 00
			39 01 00 00 00 00 11 E1 00 00 01 0f 12 15 7c 0e 01 06 06 0a 01 3e 3a 00
			39 01 00 00 00 00 09 D5 03 0B 07 08 CB A5 01 04
			15 01 00 00 00 00 02 F7 89
			15 01 00 00 00 00 02 C7 66
			15 01 00 00 00 00 02 35 00
			15 01 00 00 00 00 02 55 90
			39 01 00 00 00 00 09 D6 FF A0 88 14 04 64 28 3A 
			05 01 00 00 78 00 01 11 
			39 01 00 00 00 00 0a ee 0A 1B 5F 40 00 00 10 00 58 
			05 01 00 00 32 00 01 29 
							];
		qcom,mdss-dsi-off-command = [05 01 00 00 32 00 02 28 00
					05 01 00 00 78 00 02 10 00];
		qcom,mdss-dsi-on-command-state = "dsi_lp_mode";
		qcom,mdss-dsi-off-command-state = "dsi_lp_mode";
		qcom,mdss-dsi-h-sync-pulse = <1>;
		qcom,mdss-dsi-hfp-power-mode;
		qcom,mdss-dsi-hbp-power-mode;
		qcom,mdss-dsi-hsa-power-mode;
		qcom,mdss-dsi-bllp-eof-power-mode;
		qcom,mdss-dsi-bllp-power-mode;
		qcom,mdss-dsi-traffic-mode = <0>;	// 2
		//qcom,mdss-dsi-te-detect-mode = <1>; //legen add for esd detect
		//qcom,mdss-dsi-esd-detect-enabled; //legen add for esd detect
		qcom,mdss-dsi-lane-map = <0>;
		qcom,mdss-dsi-lane-0-state;
		qcom,mdss-dsi-lane-1-state;
		qcom,mdss-dsi-panel-timings = [73 19 11 00 3C 46 14 1C 1C 03 04 00];
		qcom,mdss-dsi-t-clk-post = <0x1f>;
		qcom,mdss-dsi-t-clk-pre = <0x2d>;
		qcom,mdss-dsi-bl-min-level = <1>;
		qcom,mdss-dsi-bl-max-level = <255>;
		qcom,mdss-dsi-rx-eot-ignore;
		qcom,mdss-dsi-tx-eot-append;
		qcom,mdss-dsi-dma-trigger = <4>;
		qcom,mdss-dsi-mdp-trigger = <0>;
		qcom,mdss-dsi-bl-pmic-control-type = "bl_ctrl_wled";
		qcom,mdss-dsi-reset-sequence = <1 20>, <0 10>, <1 20>;

	};
};
