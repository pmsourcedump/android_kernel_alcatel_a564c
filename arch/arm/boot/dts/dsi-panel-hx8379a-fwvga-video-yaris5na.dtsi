/* Copyright (c) 2013, The Linux Foundation. All rights reserved.
 *
 * This program is free software; you can redistribute it and/or modify
 * it under the terms of the GNU General Public License version 2 and
 * only version 2 as published by the Free Software Foundation.
 *
 * This program is distributed in the hope that it will be useful,
 * but WITHOUT ANY WARRANTY; without even the implied warranty of
 * MERCHANTABILITY or FITNESS FOR A PARTICULAR PURPOSE.  See the
 * GNU General Public License for more details.
 */

/*---------------------------------------------------------------------------
 * This file is autogenerated file using gcdb parser. Please do not edit it.
 * Update input XML file to add a new entry or update variable in this file
 * VERSION = "1.0"
 *---------------------------------------------------------------------------*/
&mdss_mdp {
	dsi_hx8379a_fwvga_vid: qcom,mdss_dsi_hx8379a_fwvga_video {
		qcom,mdss-dsi-panel-name = "HX8379A fwvga video mode dsi panel tdt vendor";
		qcom,mdss-dsi-panel-controller = <&mdss_dsi0>;
		qcom,mdss-dsi-panel-type = "dsi_video_mode";
		qcom,mdss-dsi-panel-destination = "display_1";
		qcom,mdss-dsi-panel-framerate = <54>;
		qcom,mdss-dsi-virtual-channel-id = <0>;
		qcom,mdss-dsi-stream = <0>;
		qcom,mdss-dsi-panel-width = <480>;
		qcom,mdss-dsi-panel-height = <854>;
		qcom,mdss-dsi-h-front-porch = <50>;
		qcom,mdss-dsi-h-back-porch = <70>;
		qcom,mdss-dsi-h-pulse-width = <20>;
		qcom,mdss-dsi-h-sync-skew = <0>;
		qcom,mdss-dsi-v-back-porch = <9>;
		qcom,mdss-dsi-v-front-porch = <15>;
		qcom,mdss-dsi-v-pulse-width = <2>;
		qcom,mdss-dsi-h-left-border = <0>;
		qcom,mdss-dsi-h-right-border = <0>;
		qcom,mdss-dsi-v-top-border = <0>;
		qcom,mdss-dsi-v-bottom-border = <0>;
		qcom,mdss-dsi-bpp = <24>;
		qcom,mdss-dsi-color-order = <0>;
		qcom,mdss-dsi-underflow-color = <0xff>;
		qcom,mdss-dsi-border-color = <0>;
		qcom,mdss-dsi-on-command = [
			39 01 00 00 00 00 04
				B9 FF 83 79
			39 01 00 00 00 00 03
				BA 51 93
			39 01 00 00 00 00 20
				B1 00 50 44
				EA 99 08 11
				11 71 1c 24     // 11 71  1a  22     +2 to black
				9A 1A 42 0B
				4A F1 00 E6    
				E6 E6 E6 E6
				00 04 05 0A
				0B 04 05 00
			39 01 00 00 00 00 0E
				B2 00 00 FE
				08 0C 19 22
				00 FF 08 0C
				19 20
			39 01 00 00 00 00 20
				B4 80 06 00
				32 10 03 32
				13 5F 32 10
				08 35 01 28
				07 37 00 3C
				1A 3E 3E 0C
				00 40 08 28
				08 30 30 04
			39 01 00 00 00 00 30
				D5 00 00 0A
				00 01 05 00
				00 18 88 99
				88 01 45 88
				88 01 45 23
				67 88 88 88
				88 88 88 88
				99 54 10 88
				88 76 32 54
				10 88 88 88
				88 88 00 00
				00 00 00 00
			39 01 00 00 00 00 04
				DE 05 70 04
			39 01 00 00 00 00 24
				E0 79 03 06  // 79 V0 1
				07 17 17 3F   // V2 61 62 63
				24 39 05 11  // V13 50  3  7     //  23  36 05 11
				10 15 17 15  // V19 25
				16 11 14 03  // p n divide
				06 07 17 17
				3F 24 39 05
				11 10 15 17
				15 16 11 14

			39 01 00 00 00 00 05
				B6 00 7C 00
				7C
			39 01 00 00 00 00 03
				C6 00 02

			15 01 00 00 00 00 02
				CC 02
			15 01 00 00 00 00 02
				35 00
			05 01 00 00 96 00 02
				11 00
			05 01 00 00 78 00 02
				29 00
			];
		qcom,mdss-dsi-off-command = [05 01 00 00 32 00 02 28 00
					05 01 00 00 78 00 02 10 00];
		qcom,mdss-dsi-on-command-state = "dsi_lp_mode";
		qcom,mdss-dsi-off-command-state = "dsi_lp_mode";
		qcom,mdss-dsi-h-sync-pulse = <1>;
		qcom,mdss-dsi-hfp-power-mode;
		qcom,mdss-dsi-hbp-power-mode;
		qcom,mdss-dsi-hsa-power-mode;
		qcom,mdss-dsi-bllp-eof-power-mode;
		qcom,mdss-dsi-bllp-power-mode;
		qcom,mdss-dsi-traffic-mode = <2>;
		//qcom,mdss-dsi-te-detect-mode = <1>; //legen add for esd detect
		//qcom,mdss-dsi-esd-detect-enabled; //legen add for esd detect
		qcom,mdss-dsi-lane-map = <0>;	// 1
		qcom,mdss-dsi-lane-0-state;
		qcom,mdss-dsi-lane-1-state;
		qcom,mdss-dsi-rx-eot-ignore;
		qcom,mdss-dsi-tx-eot-append;
		qcom,mdss-dsi-panel-timings = [73 19 11 00 3C 46 14 1C 1C 03 04 00];
		qcom,mdss-dsi-t-clk-post = <0x20>;
		qcom,mdss-dsi-t-clk-pre = <0x2d>;
		qcom,mdss-dsi-bl-min-level = <1>;
		qcom,mdss-dsi-bl-max-level = <255>;
		qcom,mdss-dsi-dma-trigger = <4>;
		qcom,mdss-dsi-mdp-trigger = <0>;
		qcom,mdss-dsi-bl-pmic-control-type = "bl_ctrl_wled";
		qcom,mdss-dsi-reset-sequence = <1 20>, <0 10>, <1 20>;

	};
};
