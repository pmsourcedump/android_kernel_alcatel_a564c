/* Copyright (c) 2013, The Linux Foundation. All rights reserved.
 *
 * This program is free software; you can redistribute it and/or modify
 * it under the terms of the GNU General Public License version 2 and
 * only version 2 as published by the Free Software Foundation.
 *
 * This program is distributed in the hope that it will be useful,
 * but WITHOUT ANY WARRANTY; without even the implied warranty of
 * MERCHANTABILITY or FITNESS FOR A PARTICULAR PURPOSE.  See the
 * GNU General Public License for more details.
 */

/dts-v1/;
/* [PLATFORM]-Mod-BEGIN by xiaopu.zhu, 2014/03/28, rename the dtsi name for soul35 */
/include/ "msm8610-v2-soul35evdo.dtsi"
/include/ "msm8610-qrd-skuaa-soul35evdo.dtsi"
/include/ "msm8610-qrd-camera-sensor-soul35evdo.dtsi"
/* [PLATFORM]-Mod-END by xiaopu.zhu */
/ {
	model = "Qualcomm MSM 8610v2 QRD SKUAA  SOUL35";
	compatible = "qcom,msm8610-qrd", "qcom,msm8610", "qcom,qrd";
	qcom,board-id = <11 1>, <11 0>;
};

