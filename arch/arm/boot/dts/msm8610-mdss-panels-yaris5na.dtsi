/* Copyright (c) 2013, The Linux Foundation. All rights reserved.
 *
 * This program is free software; you can redistribute it and/or modify
 * it under the terms of the GNU General Public License version 2 and
 * only version 2 as published by the Free Software Foundation.
 *
 * This program is distributed in the hope that it will be useful,
 * but WITHOUT ANY WARRANTY; without even the implied warranty of
 * MERCHANTABILITY or FITNESS FOR A PARTICULAR PURPOSE.  See the
 * GNU General Public License for more details.
 */
/* [PLATFORM]-Mod-BEGIN by TCTSZ.zhoujinggao, 2014/03/26, rename the dtsi name for yaris5na */
/include/ "dsi-panel-truly-wvga-video-yaris5na.dtsi"
/include/ "dsi-panel-truly-wvga-cmd-yaris5na.dtsi"
/include/ "dsi-panel-nt35590-720p-video-yaris5na.dtsi"
/include/ "dsi-panel-nt35517-qhd-video-yaris5na.dtsi"
/include/ "dsi-panel-otm8018b-fwvga-video-yaris5na.dtsi"
/*/include/ "dsi-panel-hx8379a-wvga-video-yaris5na.dtsi"*/
/include/ "dsi-panel-hx8379a-fwvga-video-yaris5na.dtsi"
/include/ "dsi-panel-hx8389b-qhd-video-yaris5na.dtsi"
/include/ "dsi-panel-ili9806c-fwvga-video-yaris5na.dtsi"
/* [PLATFORM]-Mod-END by TCTSZ.zhoujinggao */
