/* Copyright (c) 2013, The Linux Foundation. All rights reserved.
 *
 * This program is free software; you can redistribute it and/or modify
 * it under the terms of the GNU General Public License version 2 and
 * only version 2 as published by the Free Software Foundation.
 *
 * This program is distributed in the hope that it will be useful,
 * but WITHOUT ANY WARRANTY; without even the implied warranty of
 * MERCHANTABILITY or FITNESS FOR A PARTICULAR PURPOSE.  See the
 * GNU General Public License for more details.
 */

/*---------------------------------------------------------------------------
 * This file is autogenerated file using gcdb parser. Please do not edit it.
 * Update input XML file to add a new entry or update variable in this file
 * VERSION = "1.0"
 *---------------------------------------------------------------------------*/
&soc {
	dsi_nt35517_qhd_vid: qcom,mdss_dsi_nt35517_qhd_video {
		compatible = "qcom,mdss-dsi-panel";
		status = "disable";
		qcom,mdss-dsi-panel-name = "nt35517 video mode dsi panel legen modify";
		qcom,mdss-dsi-panel-controller = <&mdss_dsi0>;
		qcom,mdss-dsi-panel-type = "dsi_video_mode";
		qcom,mdss-dsi-panel-destination = "display_1";
		qcom,mdss-dsi-panel-framerate = <55>; // <55>;
		qcom,mdss-dsi-virtual-channel-id = <0>;
		qcom,mdss-dsi-stream = <0>;
		qcom,mdss-dsi-panel-width = <540>; // <480>;
		qcom,mdss-dsi-panel-height = <960>; // <854>;
		qcom,mdss-dsi-h-front-porch = <70>; // <100>;
		qcom,mdss-dsi-h-back-porch = <60>; // <100>;
		qcom,mdss-dsi-h-pulse-width = <10>; // <8>;
		qcom,mdss-dsi-h-sync-skew = <0>;
		qcom,mdss-dsi-v-back-porch = <20>; // <18>;
		qcom,mdss-dsi-v-front-porch = <20>;
		qcom,mdss-dsi-v-pulse-width = <1>; // <2>;
		qcom,mdss-dsi-h-left-border = <0>;
		qcom,mdss-dsi-h-right-border = <0>;
		qcom,mdss-dsi-v-top-border = <0>;
		qcom,mdss-dsi-v-bottom-border = <0>;
		qcom,mdss-dsi-bpp = <24>;
		qcom,mdss-dsi-color-order = <0>;
		qcom,mdss-dsi-underflow-color = <0xff>;
		qcom,mdss-dsi-border-color = <0>;
		qcom,mdss-dsi-on-command = [39 01 00 00 00 00 06
                        F0  55  AA  52  08  00
                    39 01 00 00 00 00 05
			FF AA 55 25 01
		    39 01 00 00 00 00 24
			F2 00 00 4A 0A A8 00 00 00 00 00 00 00 00 00
			00 00 00 0B 00 00 00 00 00 00 00 00 00 00 40
			01 51 00 01 00 01
		    39 01 00 00 00 00 08
                        F3 02 03 07 45 88 D1 0D
		    15 01 00 00 00 00 02
			B3 80
		    39 01 00 00 00 00 04
                        B1  CC  00  00
                    39 01 00 00 00 00 05
                        B8  01  02  02  02
                    //39 01 00 00 00 00 04
                        //BB  63  03  63
                    39 01 00 00 00 00 07
                        C9 53 06 0D 1A 17 00
//-------------------------------------
// CMD2  Page 1
//-------------------------------------
                    39 01 00 00 00 00 06
                        F0  55  AA  52  08  01
                    39 01 00 00 00 00 04
                        B0  05  05  05
                    39 01 00 00 00 00 04
                        B1  05  05  05
                    39 01 00 00 00 00 04
                        B2  01  01  01
                    39 01 00 00 00 00 04
                        B3  0D  0D  0D
                    39 01 00 00 00 00 04
                        B4  09  09  09
                    39 01 00 00 00 00 04
                        B6  44  44  44
                    39 01 00 00 00 00 04
                        B7  44  44  44
                    39 01 00 00 00 00 04
                        B8  13  13  13
                    39 01 00 00 00 00 04
                        B9  24  24  24
                    39 01 00 00 00 00 04
                        BA  24  24  24
                    39 01 00 00 00 00 04
                        BC  00  C8  00
                    39 01 00 00 00 00 04
                        BD  00  C8  00
                    //39 01 00 00 00 00 04
                       //BC  00  A0  00
                    //39 01 00 00 00 00 04
                        //BD  00  A0  00

		    15 01 00 00 00 00 02
                        BE  42
                    39 01 00 00 00 00 03
                        C0  04  00
		    15 01 00 00 00 00 02
                        CA  00

                    39 01 00 00 00 00 05
                        D0   06  10  0D  0F
                    39 01 00 00 00 00 11
                        D1  00 16 00 B3 00 D3 00 E9 00 FD 01 1D 01 3C 01 63
                    39 01 00 00 00 00 11
                        D5  00 16 00 B3 00 D3 00 E9 00 FD 01 1D 01 3C 01 63
                    39 01 00 00 00 00 11
                        D9  00 16 00 B3 00 D3 00 E9 00 FD 01 1D 01 3C 01 63
                    39 01 00 00 00 00 11
                        E0  00 16 00 B3 00 D3 00 E9 00 FD 01 1D 01 3C 01 63
                    39 01 00 00 00 00 11
                        E4  00 16 00 B3 00 D3 00 E9 00 FD 01 1D 01 3C 01 63
                    39 01 00 00 00 00 11
                        E8  00 16 00 B3 00 D3 00 E9 00 FD 01 1D 01 3C 01 63
                    39 01 00 00 00 00 11
                        D2  01 85 01 BA 01 DD 02 19 02 4B 02 4D 02 7E 02 AE
                    39 01 00 00 00 00 11
                        D6  01 85 01 BA 01 DD 02 19 02 4B 02 4D 02 7E 02 AE
                    39 01 00 00 00 00 11
                        DD  01 85 01 BA 01 DD 02 19 02 4B 02 4D 02 7E 02 AE
                    39 01 00 00 00 00 11
                        E1  01 85 01 BA 01 DD 02 19 02 4B 02 4D 02 7E 02 AE
                    39 01 00 00 00 00 11
                        E5  01 85 01 BA 01 DD 02 19 02 4B 02 4D 02 7E 02 AE
                    39 01 00 00 00 00 11
                        E9  01 85 01 BA 01 DD 02 19 02 4B 02 4D 02 7E 02 AE
                    39 01 00 00 00 00 11
                        D3  02 DC 03 10 03 31 03 57 03 78 03 9B 03 B6 03 D4
                    39 01 00 00 00 00 11
                        D7  02 DC 03 10 03 31 03 57 03 78 03 9B 03 B6 03 D4
                    39 01 00 00 00 00 11
                        DE  02 DC 03 10 03 31 03 57 03 78 03 9B 03 B6 03 D4
                    39 01 00 00 00 00 11
                        E2  02 DC 03 10 03 31 03 57 03 78 03 9B 03 B6 03 D4
                    39 01 00 00 00 00 11
                        E6  02 DC 03 10 03 31 03 57 03 78 03 9B 03 B6 03 D4
                    39 01 00 00 00 00 11
                        EA  02 DC 03 10 03 31 03 57 03 78 03 9B 03 B6 03 D4
                    39 01 00 00 00 00 05
                        D4  03 F1 03 FF
                    39 01 00 00 00 00 05
                        D8  03 F1 03 FF
                    39 01 00 00 00 00 05
                        DF  03 F1 03 FF
                    39 01 00 00 00 00 05
                        E3  03 F1 03 FF
                    39 01 00 00 00 00 05
                        E7  03 F1 03 FF
                    39 01 00 00 00 00 05
                        EB  03 F1 03 FF
// NT50198 mode
/*
		    15 01 00 00 00 00 02
                        C0 C0
		    15 01 00 00 00 00 02
                        C2 20
//\ufffd\u057e\ufffdsequence
                    39 01 00 00 00 00 05
                        FF AA 55 25 01
		    15 01 00 00 00 00 02
                        6F 0B
                    39 01 00 00 00 00 05
                        F4 12 12 56 13
*/
					05 01 00 00 78 00 02 11 00
					05 01 00 00 32 00 02 29 00];
		qcom,mdss-dsi-off-command = [05 01 00 00 32 00 02 28 00
					05 01 00 00 78 00 02 10 00];
		qcom,mdss-dsi-on-command-state = "dsi_lp_mode";
		qcom,mdss-dsi-off-command-state = "dsi_hs_mode";
		qcom,mdss-dsi-h-sync-pulse = <1>;
		qcom,mdss-dsi-traffic-mode = <1>; // <0>;
		qcom,mdss-dsi-lane-map = <1>;
		qcom,mdss-dsi-bllp-eof-power-mode;
		qcom,mdss-dsi-bllp-power-mode;
		qcom,mdss-dsi-lane-0-state;
		qcom,mdss-dsi-lane-1-state;
		qcom,mdss-dsi-panel-timings = [33 1e 14 00 44 48 18 22 19 03 04 00];
		qcom,mdss-dsi-t-clk-post = <0x04>;
		qcom,mdss-dsi-t-clk-pre = <0x1F>;
		qcom,mdss-dsi-bl-min-level = <1>;
		qcom,mdss-dsi-bl-max-level = <4095>;
		qcom,mdss-dsi-dma-trigger = <4>;
		qcom,mdss-dsi-mdp-trigger = <0>;
		qcom,mdss-dsi-bl-pmic-control-type = "bl_ctrl_wled";
		qcom,mdss-dsi-reset-sequence = <1 1>, <0 20>, <1 120>;
	};
};
